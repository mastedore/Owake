/*
	info.cpp

	Implements the 'About' subsystem in Owake.


	Copyright (C) 2025-2026 Marcos Rubiano
	email:	markusianito@proton.me

	This program is free software: you can redistribute it and/or modify
	it under the terms of the GNU General Public License as published by
	the Free Software Foundation, either version 3 of the License, or
	(at your option) any later version.

	This program is distributed in the hope that it will be useful,
	but WITHOUT ANY WARRANTY; without even the implied warranty of
	MERCHANTABILITY or FITNESS FOR A PARTICULAR PURPOSE.  See the
	GNU General Public License for more details.

	You should have received a copy of the GNU General Public License
	along with this program.  If not, see <https://www.gnu.org/licenses/>.
*/


#include "state.hpp"
#include <avr/pgmspace.h>

constexpr char endline = 0x0b;
constexpr char pause = 0x0a;
constexpr char stop = 0x0c;

static void typeEffect(const char *text)
{
	int col = 0, row = 0;
	int textIndex = 0;

	// Type out the text
	while (text[textIndex] != stop)
	{
		char c = text[textIndex++];

		if (c == endline)
		{
			row++;
			col = 0;
			lcd.writePosition(col, row);
		}
		else if (c == pause)
		{
			delay(1500);
			// Delete the text
			while (col > 0 || row > 0)
			{
				if (col > 0)
				{
					col--;
				}
				else if (row > 0)
				{
					row--;
					col = 15; // Assuming 16-char wide display
				}

				lcd.writePosition(col, row);
				lcd.writeChar(' ');
				delay(66);
			}
		}
		else
		{
			lcd.writePosition(col, row);
			lcd.writeChar(c);
			col++;
			delay(84);
		}
	}

	delay(2000);

	lcd.writePosition(0, 0);
}

static void print(char p)
{
	lcd.writeChar(p);
}

void Credits::Main::setup(StateCtx *ctx)
{
	defineFont(0);
	lcd.cursor(true);
	lcd.blink(true);
}

void Credits::Main::loop(StateCtx *ctx)
{
	delay(2000);
	lcd.blink(true);
	lcd.cursor(true);
	const char opcodes[] = {0x54, 0x68, 0x65, 0x20, 0x0, 0x1, 0x2, 0x3, 0x4, 0xb, 0x50, 0x72, 0x6f,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 0x33, 0xc};

	typeEffect(opcodes);

	ctx->self->sys->requestShiftSubsystem(OwakeSubsystemID::MENU);
	return;
}

void Credits::Main::exit(StateCtx *ctx)
{
}
