/*
	info.cpp

	Implements the 'About' subsystem in Owake.


	Copyright (c) 2025-2026 Mastedore <marcos@mastedore.com>

	This program is free software: you can redistribute it and/or modify
	it under the terms of the GNU General Public License as published by
	the Free Software Foundation, either version 3 of the License, or
	(at your option) any later version.

	This program is distributed in the hope that it will be useful,
	but WITHOUT ANY WARRANTY; without even the implied warranty of
	MERCHANTABILITY or FITNESS FOR A PARTICULAR PURPOSE.  See the
	GNU General Public License for more details.

	You should have received a copy of the GNU General Public License
	along with this program.  If not, see <https://www.gnu.org/licenses/>.
*/


#include <avr/wdt.h>
#include <avr/pgmspace.h>

#include "state.hpp"

constexpr char endline = 0x0b;
constexpr char pause = 0x0a;
constexpr char stop = 0x0c;

// Lives in flash so it doesn't take ~190 bytes of stack. Bytes 0x00-0x07
// are the custom glyphs loaded by defineFont(0), and the three control
// bytes above drive typeEffect().
static const char opcodes[] PROGMEM = {0x54, 0x68, 0x65, 0x20, 0x00, 0x01, 0x02, 0x03, 0x04, 0x0b, 0x50, 0x72, 0x6f,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 0x33, 0x0c};

// text must point to flash (PROGMEM).
static void typeEffect(const char *text)
{
	uint8_t col = 0, row = 0;
	uint8_t textIndex = 0;

	char c;
	while ((c = static_cast<char>(pgm_read_byte(&text[textIndex++]))) != stop)
	{
		wdt_reset();

		if (c == endline)
		{
			row++;
			col = 0;
			lcd.writePosition(col, row);
		}
		else if (c == pause)
		{
			delay(1500);
			// Erase backwards, one cell at a time, like a backspace.
			while (col > 0 || row > 0)
			{
				wdt_reset();
				if (col > 0)
				{
					col--;
				}
				else if (row > 0)
				{
					row--;
					col = COLS - 1;
				}

				lcd.writePosition(col, row);
				lcd.writeChar(' ');
				delay(66);
			}
		}
		else
		{
			lcd.writePosition(col, row);
			lcd.writeChar(static_cast<uint8_t>(c));
			col++;
			delay(84);
		}
	}

	delay(2000);

	lcd.writePosition(0, 0);
}

void Credits::Main::setup(StateCtx *ctx)
{
	defineFont(0);
	lcd.cursor(true);
	lcd.blink(true);
}

void Credits::Main::loop(StateCtx *ctx)
{
	delay(2000);
	lcd.blink(true);
	lcd.cursor(true);

	typeEffect(opcodes);

	ctx->self->sys->requestShiftSubsystem(OwakeSubsystemID::MENU);
	return;
}

void Credits::Main::exit(StateCtx *ctx)
{
}
